
/ {

    behaviors {
        tp: tap_preferred {
            compatible = "zmk,behavior-hold-tap";
            label = "TAP_PREFERRED";
            bindings = <&kp>, <&kp>;

            #binding-cells = ;
            tapping-term-ms = ;
            quick-tap-ms = ;
            flavor = "tap-preferred";
        };
    };

};